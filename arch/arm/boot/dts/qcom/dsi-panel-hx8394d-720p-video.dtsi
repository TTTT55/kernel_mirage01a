/* Copyright (c) 2014, The Linux Foundation. All rights reserved.
 *
 * This program is free software; you can redistribute it and/or modify
 * it under the terms of the GNU General Public License version 2 and
 * only version 2 as published by the Free Software Foundation.
 *
 * This program is distributed in the hope that it will be useful,
 * but WITHOUT ANY WARRANTY; without even the implied warranty of
 * MERCHANTABILITY or FITNESS FOR A PARTICULAR PURPOSE.  See the
 * GNU General Public License for more details.
 */

/*---------------------------------------------------------------------------
 * This file is autogenerated file using gcdb parser. Please do not edit it.
 * Update input XML file to add a new entry or update variable in this file
 * VERSION = "1.0"
 *---------------------------------------------------------------------------*/
&mdss_mdp {
	dsi_hx8394d_720_vid: qcom,mdss_dsi_hx8394d_720p_video {
		qcom,mdss-dsi-panel-name = "hx8394d 720p video mode dsi panel";
		qcom,mdss-dsi-panel-controller = <0x6b>;
		qcom,mdss-dsi-panel-type = "dsi_video_mode";
		qcom,mdss-dsi-panel-destination = "display_1";
		qcom,mdss-dsi-panel-framerate = <0x3e>;
		qcom,mdss-dsi-virtual-channel-id = <0x0>;
		qcom,mdss-dsi-stream = <0x0>;
		qcom,mdss-dsi-panel-width = <0x2d0>;
		qcom,mdss-dsi-panel-height = <0x500>;
		qcom,mdss-dsi-h-front-porch = <0x34>;
		qcom,mdss-dsi-h-back-porch = <0x64>;
		qcom,mdss-dsi-h-pulse-width = <0x18>;
		qcom,mdss-dsi-h-sync-skew = <0x0>;
		qcom,mdss-dsi-v-back-porch = <0x14>;
		qcom,mdss-dsi-v-front-porch = <0x8>;
		qcom,mdss-dsi-v-pulse-width = <0x4>;
		qcom,mdss-dsi-h-left-border = <0x0>;
		qcom,mdss-dsi-h-right-border = <0x0>;
		qcom,mdss-dsi-v-top-border = <0x0>;
		qcom,mdss-dsi-v-bottom-border = <0x0>;
		qcom,mdss-dsi-bpp = <0x18>;
		qcom,mdss-dsi-underflow-color = <0xff>;
		qcom,mdss-dsi-border-color = <0x0>;
		qcom,mdss-dsi-on-command = [39 01 00 00 00 00 04 b9 ff 83 94 39 01 00 00 00 00 03 ba 73 83 39 01 00 00 00 00 10 b1 6c 12 12 26 04 11 f1 81 3a 54 23 80 c0 d2 58 39 01 00 00 00 00 0c b2 00 64 0e 0d 22 1c 08 08 1c 4d 00 39 01 00 00 00 00 0d b4 00 ff 51 5a 59 5a 03 5a 01 70 20 70 39 01 00 00 00 00 02 bc 07 39 01 00 00 00 00 04 bf 41 0e 01 39 01 00 00 00 00 1f d3 00 0f 00 40 07 10 00 08 10 08 00 08 54 15 0e 05 0e 02 15 06 05 06 47 44 0a 0a 4b 10 07 07 39 01 00 00 00 00 2d d5 1a 1a 1b 1b 00 01 02 03 04 05 06 07 08 09 0a 0b 24 25 18 18 26 27 18 18 18 18 18 18 18 18 18 18 18 18 18 18 18 18 20 21 18 18 18 18 39 01 00 00 00 00 2d d6 1a 1a 1b 1b 0b 0a 09 08 07 06 05 04 03 02 01 00 21 20 58 58 27 26 18 18 18 18 18 18 18 18 18 18 18 18 18 18 18 18 25 24 18 18 18 18 39 01 00 00 00 00 2b e0 05 12 1b 20 39 3f 24 39 08 0a 0c 16 10 14 17 15 17 0a 0f 11 17 05 12 1b 27 39 3f 21 3a 04 07 0b 16 0f 14 17 15 17 0a 0f 11 17 39 01 00 00 00 00 02 bd 00 39 01 00 00 00 00 2c c1 01 00 06 0b 11 18 25 2d 33 40 4a 53 5a 62 6b 74 7c 84 8c 94 9c a3 ab b3 ba c1 ca d1 d8 e1 e8 f1 f8 ff 32 94 23 52 5a e5 c7 21 c0 39 01 00 00 00 00 02 bd 01 39 01 00 00 00 00 2b c1 00 06 0b 11 18 25 2d 33 40 4a 53 5a 62 6b 74 7c 84 8c 94 9c a3 ab b3 ba c1 ca d1 d8 e1 e8 f1 f8 ff 32 94 23 52 5a e5 c7 21 c0 39 01 00 00 00 00 02 bd 02 39 01 00 00 00 00 2b c1 00 06 0b 11 18 25 2d 33 40 4a 53 5a 62 6b 74 7c 84 8c 94 9c a3 ab b3 ba c1 ca d1 d8 e1 e8 f1 f8 ff 32 94 23 52 5a e5 c7 21 c0 39 01 00 00 00 00 02 cc 01 39 01 00 00 00 00 02 36 02 39 01 00 00 00 00 05 c7 00 c0 00 c0 05 01 00 00 c8 00 02 11 00 05 01 00 00 00 00 02 29 00];
		qcom,mdss-dsi-off-command = [05 01 00 00 00 00 02 28 00 05 01 00 00 00 00 02 10 00];
		qcom,mdss-dsi-on-command-state = "dsi_lp_mode";
		qcom,mdss-dsi-off-command-state = "dsi_hs_mode";
		qcom,mdss-dsi-h-sync-pulse = <0x1>;
		qcom,mdss-dsi-traffic-mode = "burst_mode";
		qcom,mdss-dsi-lane-map = "lane_map_0123";
		qcom,mdss-dsi-bllp-eof-power-mode;
		qcom,mdss-dsi-bllp-power-mode;
		qcom,mdss-dsi-lane-0-state;
		qcom,mdss-dsi-lane-1-state;
		qcom,mdss-dsi-lane-2-state;
		qcom,mdss-dsi-lane-3-state;
		qcom,mdss-dsi-panel-timings = <0x821c1200 0x4042161e 0x14030400>;
		qcom,mdss-dsi-t-clk-post = <0x4>;
		qcom,mdss-dsi-t-clk-pre = <0x1b>;
		qcom,mdss-dsi-bl-min-level = <0x1>;
		qcom,mdss-dsi-bl-max-level = <0xfff>;
		qcom,mdss-dsi-bl-pmic-pwm-frequency = <0x64>;
		qcom,mdss-dsi-bl-pmic-bank-select = <0x0>;
		qcom,mdss-dsi-dma-trigger = "trigger_sw";
		qcom,mdss-dsi-mdp-trigger = "none";
		qcom,mdss-dsi-bl-pmic-control-type = "bl_ctrl_pwm";
		qcom,mdss-dsi-reset-sequence = <0x1 0x14 0x0 0x1 0x1 0x14>;
		qcom,mdss-pan-physical-width-dimension = <0x3b>;
		qcom,mdss-pan-physical-height-dimension = <0x68>;
		qcom,cont-splash-enabled;
		qcom,esd-check-enabled;

	};
};
